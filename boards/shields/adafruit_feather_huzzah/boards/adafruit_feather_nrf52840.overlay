/*
 * Copyright (c) 2020 Tobias Svehagen
 *
 * SPDX-License-Identifier: Apache-2.0
 */

/ {
	chosen {
		zephyr,console = &uart1;
		zephyr,shell-uart = &uart1;
	};
};

/* NonOS AT 1.7 */
&feather_serial {
	tx-pin = <24>; /* RX */
	rx-pin = <25>; /* TX */
	rts-pin = <6>; /* D11 */
	cts-pin = <27>; /* D10 */
	current-speed = <115200>;
	hw-flow-control;
	status = "okay";
};

&uart1 {
	status = "okay";
	current-speed = <115200>;
	tx-pin = <2>; /* A4 */
	rx-pin = <3>; /* A5 */
};
