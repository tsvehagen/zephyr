/*
 * Copyright (c) 2020 Tobias Svehagen
 *
 * SPDX-License-Identifier: Apache-2.0
 */

&feather_serial {
	current-speed = <115200>;

	esp8266 {
		compatible = "espressif,esp";
		label = "esp8266";
		status = "okay";
	};
};
