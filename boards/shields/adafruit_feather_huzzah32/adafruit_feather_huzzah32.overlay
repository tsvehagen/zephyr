/*
 * Copyright (c) 2020 Tobias Svehagen
 *
 * SPDX-License-Identifier: Apache-2.0
 */

&feather_serial {
	current-speed = <115200>;

	esp32 {
		compatible = "espressif,esp";
		label = "esp32";
		status = "okay";
	};
};
