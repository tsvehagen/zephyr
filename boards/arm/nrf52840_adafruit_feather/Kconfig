## boards/arm/nrf52840_adafruit_feather/Kconfig
```kconfig
# Kconfig - nRF52840 Adafruit Feather board configuration
#
# SPDX-License-Identifier: Apache-2.0

if BOARD_NRF52840_ADAFRUIT_FEATHER

config BOARD_ENABLE_DCDC
	bool "Enable DCDC mode"
	select SOC_DCDC_NRF52X
	default y

endif # BOARD_NRF52840_ADAFRUIT_FEATHER
```

## boards/arm/nrf52840_adafruit_feather/Kconfig.board
```kconfig
# Kconfig - nRF52840 Adafruit Feather board configuration
#
# SPDX-License-Identifier: Apache-2.0

config BOARD_NRF52840_ADAFRUIT_FEATHER
	bool "nRF52840 ADAFRUIT FEATHER"
	depends on SOC_NRF52840_QIAA
```

## boards/arm/nrf52840_adafruit_feather/Kconfig.defconfig
```kconfig
# Kconfig - nRF52840 Adafruit Feather board configuration
#
# SPDX-License-Identifier: Apache-2.0

if BOARD_NRF52840_ADAFRUIT_FEATHER

config BOARD
	default "nrf52840_adafruit_feather"

if USB

config USB_NRF52840
	default y

config USB_DEVICE_STACK
	default y

endif # USB

if IEEE802154

config IEEE802154_NRF5
	default y

endif # IEEE802154

config BT_CTLR
	default BT

endif # BOARD_NRF52840_ADAFRUIT_FEATHER
```

## boards/shields/adafruit_feather_huzzah/Kconfig.defconfig
```kconfig
# Copyright (c) 2020 Tobias Svehagen
# SPDX-License-Identifier: Apache-2.0

if SHIELD_ADAFRUIT_FEATHER_HUZZAH

if NETWORKING

config WIFI_ESP
	default y

config WIFI_ESP_AT_VERSION_1_7

endif # NETWORKING

endif # SHIELD_ADAFRUIT_FEATHER_HUZZAH
```

## boards/shields/adafruit_feather_huzzah/Kconfig.shield
```kconfig
# Copyright (c) 2020 Tobias Svehagen
# SPDX-License-Identifier: Apache-2.0

config SHIELD_ADAFRUIT_FEATHER_HUZZAH
	def_bool $(shields_list_contains,adafruit_feather_huzzah)
```

## boards/shields/adafruit_feather_huzzah32/Kconfig.defconfig
```kconfig
# Copyright (c) 2020 Tobias Svehagen
# SPDX-License-Identifier: Apache-2.0

if SHIELD_ADAFRUIT_FEATHER_HUZZAH32

if NETWORKING

config WIFI_ESP
	default y

config WIFI_ESP_AT_VERSION_2_0

endif # NETWORKING

endif # SHIELD_ADAFRUIT_FEATHER_HUZZAH32
```

## boards/shields/adafruit_feather_huzzah32/Kconfig.shield
```kconfig
# Copyright (c) 2020 Tobias Svehagen
# SPDX-License-Identifier: Apache-2.0

config SHIELD_ADAFRUIT_FEATHER_HUZZAH32
	def_bool $(shields_list_contains,adafruit_feather_huzzah32)
```

## drivers/wifi/esp8266/Kconfig.esp8266
```kconfig
# Copyright (c) 2019 Tobias Svehagen
# SPDX-License-Identifier: Apache-2.0

menuconfig WIFI_ESP8266
	bool "Espressif esp8266 support"
	select MODEM
	select MODEM_CONTEXT
	select MODEM_CMD_HANDLER
	select MODEM_IFACE_UART
	select NET_L2_WIFI_MGMT
	select WIFI_OFFLOAD

if WIFI_ESP8266

config WIFI_ESP8266_NAME
	string "Driver name"
	default "esp8266"

config WIFI_ESP8266_RX_STACK_SIZE
	int "Stack size for the Espressif esp8266 wifi driver RX thread"
	default 1028
	help
	  This stack is used by the Espressif esp8266 RX thread.

config WIFI_ESP8266_WORKQ_STACK_SIZE
	int "Stack size for the esp8266 driver work queue"
	default 2048
	help
	  This stack is used by the work queue to pass off net_pkt data
	  to the rest of the network stack, letting the rx thread continue
	  processing data.

config WIFI_ESP8266_PASSIVE_TCP
	bool "Use passive TCP"
	default y
	help
	  This lets the esp8266 handle the TCP window so that data can flow
	  at a rate that the driver can handle. Without this, data might get
	  lost if the driver cannot empty the device buffer quickly enough.

endif # WIFI_ESP8266
```

## dts/bindings/wifi/espressif,esp.yaml
```yaml
# Copyright (c) 2019 Tobias Svehagen
# SPDX-License-Identifier: Apache-2.0

description: Espressif ESP8266/ESP32 WiFi modem (AT Commands)

compatible: "espressif,esp"

include: spi-device.yaml

properties:
    label:
      required: true

    wifi-reset-gpios:
      type: phandle-array
      required: false
```

## dts/bindings/wifi/espressif,esp8266.yaml
```yaml
# Copyright (c) 2019 Tobias Svehagen
# SPDX-License-Identifier: Apache-2.0

description: Espressif ESP8266 WiFi modem (AT Commands)

compatible: "espressif,esp8266"

include: uart-device.yaml

properties:
    label:
      required: true

    wifi-reset-gpios:
      type: phandle-array
      required: false
```
