/* Copyright (c) 2020 Tobais Svehagen */
/* SPDX-License-Identifier: Apache-2.0 */

&spi1 {
	status = "okay";

	esp32-solo@2 {
		compatible = "espressif,esp";
		label = "esp32";
		reg = <2>;
		spi-max-frequency = <80000>;
		status = "okay";
	};
};

&spi2 {
	status = "disabled";
};
